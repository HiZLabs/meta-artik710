## conf/machine/artik710.conf
```bitbake
#@TYPE: Machine
#@NAME: Samsung Artik 710
#@SOC:ARM Cortex-A53
#@DESCRIPTION: Machine configuration for Samsung Artik 710

IMAGE_CLASSES += "artik710-sdimg"

MACHINE_FEATURES += " bluetooth pci rtc ethernet serial usbgadget wifi"

IMAGE_FSTYPES += "artik710-sdimg"

MACHINE_ESSENTIAL_EXTRA_RRECOMMENDS += "kernel-modules"

KERNEL_MODULE_AUTOLOAD += "dhd"
KERNEL_MODULE_PROBECONF += "dhd"

require conf/machine/include/arm/arch-armv8.inc

PREFERRED_PROVIDER_u-boot = "u-boot-artik710"
PREFERRED_PROVIDER_virtual/kernel = "linux-yocto-artik710"

# Kernel
KERNEL_DEVICETREE ?= "nexell/s5p6818-artik710-raptor-rev00.dtb \
    nexell/s5p6818-artik710-raptor-rev01.dtb \
    nexell/s5p6818-artik710-raptor-rev03.dtb \
    "
KERNEL_IMAGETYPE = "Image"
KBUILD_DEFCONFIG = "artik710_raptor_defconfig"

# Use uboot_mkimage
UBOOT_ENTRYPOINT = "0x40080000"
KEEPUIMAGE = "no"

# U-boot
UBOOT_MACHINE = "artik710_raptor_config"

BASE_MACH = "s5p6818"
FIP_LOAD_ADDR = "0x7df00000"

SERIAL_CONSOLE = "115200 ttySAC3"

# Artik 710 uses another firmware for WiFi and BT
MACHINE_ESSENTIAL_EXTRA_RRECOMMENDS += "bcm43455c0-wifi"
MACHINE_ESSENTIAL_EXTRA_RRECOMMENDS += "bcm4345-bt"
module_conf_dhd = "options dhd firmware_path=/etc/wifi/fw.bin nvram_path=/etc/wifi/nvram.txt"

MACHINE_FEATURES += " usbhost"
```
